## drivers/mct/Kconfig
```kconfig
#
# MCT device configuration
#
menuconfig MCT
	bool "MCT support"
	help
		If you want MCT extensions, you should say Y here. 
		Some MCT drivers, are Top-Level SPI drivers, so you
		have to configure SPI_MASTER first!
		See below what kind of, and then take your selection.

if MCT

config MCT_DEBUG
	boolean "Debug Support"
	default y
	help 
		Say "yes" to enable MCT debugging messages.
		Normally, you should say 'N'.

config MCT_DEBUG_VERBOSE
	int "Debugging verbosity (0=quiet, 1=init/exit 2=timer/spi, 3=noise[json] 4=verbose[keys])"
	depends on MCT_DEBUG
	default "0"
	help
		Determines the verbosity level of the MCT debugging messages.

config MCT_PAA_SUBSYS
	boolean "PAA Sub-System Support"
	default y
	help
		Determines the extension of process mirror.
#----------------------------------------------
comment "Type: GENERIC-drivers"

source "drivers/mct/pin_di/Kconfig"

comment "Type: SPI-drivers"

source "drivers/mct/spi_dio/Kconfig"

source "drivers/mct/spi_aio/Kconfig"

if MCT_PAA_SUBSYS
	source "drivers/mct/paa/Kconfig"
endif #MCT_PAA_SUBSYS

endif #MCT
```

## drivers/mct/paa/Kconfig
```kconfig
#
# MCT PAA configuration
#

# -------------------------
# CORE-PART
# -------------------------
comment "Type: PAA-drivers"
config MCT_PAA
	tristate "PAA-Core-component"
	depends on MCT_PAA_SUBSYS
	default m
	help
	  Please select core component!

# -------------------------
# MASTER-PART
# -------------------------
menu "PAA-masters"
depends on MCT_PAA

config MCT_PAA_SPI
	tristate "PAA-master over SPI"
	default y
	depends on SPI
	help
	  This selects master driver over SPI.

#config MCT_PAA_COM
#	tristate "PAA-master over COM"
#	help	
#	  This selects master driver over COM.

config MCT_PAA_DEBUG
	bool "Add paa-master debug support" 
	default y
	depends on MCT_DEBUG && (MCT_PAA_SPI || MCT_PAA_COM) 
	help
	Select this if you want to have special master debug support!

config MCT_PAA_SLOTS_MAX
	int "Paa-slaves maximum supported (1...6)"
	depends on MCT_PAA_SPI || MCT_PAA_COM
	default "6"
	help
		Determines the paa-slots used for paa-slave-drivers.
		Amount of these will supported by paa-master.
		If compiled paa-master as build-in-driver the paa-slots
		amount will be fixed in kernel.
		If compiled paa-master as module-driver the paa-slosts
		amount can overloaded by command line parameter.
endmenu

# ---------------------------------
# SLAVE-PART
# ---------------------------------
menu "PAA-slaves"
depends on MCT_PAA && (MCT_PAA_SPI || MCT_PAA_COM)

source "drivers/mct/paa/di4/Kconfig"

source "drivers/mct/paa/di10/Kconfig"

source "drivers/mct/paa/do4/Kconfig"

source "drivers/mct/paa/dio42/Kconfig"

source "drivers/mct/paa/ai8/Kconfig"

source "drivers/mct/paa/ao4/Kconfig"

endmenu
```

## drivers/mct/paa/ai8/Kconfig
```kconfig
config MCT_PAA_AI8
	tristate "paa ai8 slave - Attention: Don't use <*> only <M> or < >!"
	default m
	help
	  This selects ai8 driver as module.
config MCT_PAA_AI8_DEV_IF_MBUS
	bool "Add M-Bus protocol" 
	default n
	depends on MCT_PAA_AI8 
	help
	 Select this if you want to have an MBUS client device interface!
config MCT_PAA_AI8_DEV_IF_MODBUS
	bool "Add Modbus protocol" 
	default n
	depends on MCT_PAA_AI8 
	help
	 Select this if you want to have an MODBUS slave device interface!
config MCT_PAA_AI8_DEV_DEBUG
	bool "Add debug support" 
	default n
	depends on MCT_DEBUG && MCT_PAA_AI8 
	help
	Select this if you want to have special ai8-lbus-device debug support!
```

## drivers/mct/paa/ao4/Kconfig
```kconfig
config MCT_PAA_AO4
	tristate "paa ao4 slave - Attention: Don't use <*> only <M> or < >!"
	default m
	help
	  This selects ao4 driver as module.
config MCT_PAA_AO4_DEV_IF_MBUS
	bool "Add M-Bus protocol" 
	default n
	depends on MCT_PAA_AO4 
	help
	 Select this if you want to have an MBUS client device interface!
config MCT_PAA_AO4_DEV_IF_MODBUS
	bool "Add Modbus protocol" 
	default n
	depends on MCT_PAA_AO4 
	help
	 Select this if you want to have an MODBUS slave device interface!
config MCT_PAA_AO4_DEV_DEBUG
	bool "Add debug support" 
	default n
	depends on MCT_DEBUG && MCT_PAA_AO4
	help
	Select this if you want to have special ao4-lbus-device debug support!
```

## drivers/mct/paa/di4/Kconfig
```kconfig
config MCT_PAA_DI4
	tristate "paa di4 slave - Attention: Don't use <*> only <M> or < >!"
	default m
	help
	This selects di4 driver as module.
config MCT_PAA_DI4_DEV_IF_MBUS
	bool "Add M-Bus protocol" 
	default n
	depends on MCT_PAA_DI4 
	help
	 Select this if you want to have an MBUS client device interface!
config MCT_PAA_DI4_DEV_IF_MODBUS
	bool "Add Modbus protocol" 
	default n
	depends on MCT_PAA_DI4 
	help
	 Select this if you want to have an MODBUS slave device interface!
config MCT_PAA_DI4_DEV_DEBUG
	bool "Add debug support" 
	default n
	depends on MCT_DEBUG && MCT_PAA_DI4 
	help
	Select this if you want to have special di4-lbus-device debug support!
```

## drivers/mct/paa/dio42/Kconfig
```kconfig
config MCT_PAA_DIO42
	tristate "paa dio42 slave - Attention: Don't use <*> only <M> or < >!"
	default m
	help
	  This selects dio42 driver as module.
config MCT_PAA_DIO42_DEV_IF_MBUS
	bool "Add M-Bus protocol" 
	default n
	depends on MCT_PAA_DIO42 
	help
	 Select this if you want to have an MBUS client device interface!
config MCT_PAA_DIO42_DEV_IF_MODBUS
	bool "Add Modbus protocol" 
	default n
	depends on MCT_PAA_DIO42 
	help
	 Select this if you want to have an MODBUS slave device interface!
config MCT_PAA_DIO42_DEV_DEBUG
	bool "Add debug support" 
	default n
	depends on MCT_DEBUG && MCT_PAA_DIO42
	help
	Select this if you want to have special dio42-lbus-device debug support!
```

## drivers/mct/paa/do4/Kconfig
```kconfig
config MCT_PAA_DO4
	tristate "paa do4 slave - Attention: Don't use <*> only <M> or < >!"
	default m
	help
	  This selects do4 driver as module.
config MCT_PAA_DO4_DEV_IF_MBUS
	bool "Add M-Bus protocol" 
	default n
	depends on MCT_PAA_DO4 
	help
	 Select this if you want to have an MBUS client device interface!
config MCT_PAA_DO4_DEV_IF_MODBUS
	bool "Add Modbus protocol" 
	default n
	depends on MCT_PAA_DO4 
	help
	 Select this if you want to have an MODBUS slave device interface!
config MCT_PAA_DO4_DEV_DEBUG
	bool "Add debug support" 
	default n
	depends on MCT_DEBUG&& MCT_PAA_DO4 
	help
	Select this if you want to have special do4-lbus-device debug support!
```

## drivers/mct/pin_di/Kconfig
```kconfig
config MCT_PIN_DI
	tristate "digital input (PIN)"
	depends on MCT
	default n
	help
	If you want MCT digital input support (PIN), you should 
	say Y here.  This driver deals directly with the controller 
	pins and works as simple input(s), counter(s) or frequence(s).
	This generic input support can also be built as a module.  
	If so, the module will be called mct_pin_inp.ko.
config MCT_PIN_DI_DEV_IF_MBUS
	bool "Add M-Bus protocol" 
	default n
	depends on MCT_PIN_DI 
	help
	Select this if you want to have an MBUS client device interface!
config MCT_PIN_DI_DEV_IF_MODBUS
	bool "Add Modbus protocol" 
	default n
	depends on MCT_PIN_DI 
	help
	 Select this if you want to have an MODBUS slave device interface!
config MCT_PIN_DI_DEV_DEBUG
	bool "Add debug support" 
	default n
	depends on MCT_PIN_DI && MCT_DEBUG 
	help
	Select this if you want to have special device debug support!
```

## drivers/mct/spi_aio/Kconfig
```kconfig
#
# MCT device pic over spi configuration
#
config MCT_SPI_AIO
	tristate "ananlog in/out driver (SPI-UART-PIC)"
	depends on MCT && SPI
	default n
	help
	If you want MCT spi digital in/out support, you should 
	say Y here. This driver deals with the SPI_MASTER controller 
	and works on the top.
	This driver can also be built as a module.  
	If so, the module will be called mct_out.
config MCT_SPI_AIO_DEV_IF_MBUS
	bool "Add M-Bus protocol" 
	default n
	depends on MCT_SPI_AIO
	help
	Select this if you want to have an MBUS client device interface!
config MCT_SPI_AIO_DEV_IF_MODBUS
	bool "Add Modbus protocol" 
	default n
	depends on MCT_SPI_AIO 
	help
	 Select this if you want to have an MODBUS slave device interface!
config MCT_SPI_AIO_DEV_DEBUG
	bool "Add debug support" 
	default n
	depends on MCT_SPI_AIO && MCT_DEBUG && SPI
	help
	Select this if you want to have special device debug support!
```

## drivers/mct/spi_dio/Kconfig
```kconfig
config MCT_SPI_DIO
	tristate "digital in/out driver (SPI-SER/PAR)"
	depends on MCT && SPI
	default n
	help
	If you want MCT spi digital in/out support, you should 
	say Y here. This driver deals with the SPI_MASTER controller 
	and works on the top.
	This driver can also be built as a module.  
	If so, the module will be called mct_out.
config MCT_SPI_DIO_DEV_IF_MBUS
	bool "Add M-Bus protocol" 
	default n
	depends on MCT_SPI_DIO
	help
	Select this if you want to have an MBUS client device interface!
config MCT_SPI_DIO_DEV_IF_MODBUS
	bool "Add Modbus protocol" 
	default n
	depends on MCT_SPI_DIO 
	help
	 Select this if you want to have an MODBUS slave device interface!
config MCT_SPI_DIO_DEV_DEBUG
	bool "Add debug support" 
	default n
	depends on MCT_SPI_DIO && MCT_DEBUG  && SPI 
	help
	Select this if you want to have special device debug support!
```
